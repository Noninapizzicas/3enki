## modules/esp32-dev/templates/esp32-p4-cocina/sdkconfig.defaults
```kconfig
# ESP32-P4 Pantalla Cocina — SDK Configuration
# Based on ESP-IDF v5.5 hello_world defaults

CONFIG_IDF_TARGET="esp32p4"

# WiFi
CONFIG_ESP_WIFI_SSID=""
CONFIG_ESP_WIFI_PASSWORD=""
CONFIG_ESP_MAXIMUM_RETRY=5

# Networking
CONFIG_ESP_NETIF_IP_LOST_PRINT_ENABLED=y

# MQTT
CONFIG_MQTT_PROTOCOL_311=y

# NVS (Persistent storage)
CONFIG_NVS_ENCRYPTION=n

# LVGL (minimal config)
CONFIG_LV_CONF_SKIP=n

# Display (LCD)
CONFIG_ESP_LCD_ENABLE=y

# FreeRTOS (standard config from v5.5)
CONFIG_FREERTOS_TASK_PRE_DELETION_HOOK=y

# Logging (moderate)
CONFIG_LOG_DEFAULT_LEVEL=INFO
CONFIG_LOG_MAXIMUM_LEVEL=DEBUG

# Main task stack
CONFIG_ESP_MAIN_TASK_STACK_SIZE=4096

# Watchdog
CONFIG_ESP_TASK_WDT_EN=y
CONFIG_ESP_TASK_WDT_TIMEOUT_S=30

# Memory
CONFIG_SPIRAM_MALLOC_ALWAYSINTERNAL=n

# Compiler
CONFIG_COMPILER_OPTIMIZATION_SIZE=y
```
